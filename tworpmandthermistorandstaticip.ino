#include <Arduino.h>
#include <WiFi.h>
#include <AsyncTCP.h>
#include <ESPAsyncWebServer.h>
// spiffs makes the file system 
#include "SPIFFS.h"
#include <Arduino_JSON.h>   
#include <stdio.h>

//TAKEN FROM https://randomnerdtutorials.com/esp32-websocket-server-sensor/

//thermistor instantitations 
bool esp32 = true;       // change to false when using Arduino

int ThermistorPin;
double adcMax, Vs;

double R1 = 10000.0;   // voltage divider resistor value
double Beta = 3950.0;  // Beta value
double To = 298.15;    // Temperature in Kelvin for 25 degree Celsius
double Ro = 10000.0;   // Resistance of Thermistor at 25 degree Celsius

// The ESP32 lookup table varies from device to device, use the program from 
// https://github.com/e-tinkers/esp32-adc-calibrate
// to generate lookup table for your own ESP32
const float ADC_LUT[4096] PROGMEM = { 0,
32.8000,34.0000,35.4000,36.8000,38.0000,39.2000,40.8000,41.8000,43.0000,44.6000,45.8000,47.0000,48.4000,49.8000,50.8000,
52.0000,53.2000,54.6000,55.8000,57.0000,58.0000,59.6000,60.8000,62.0000,63.0000,64.4000,65.4000,66.6000,67.8000,68.8000,
69.8000,70.8000,71.8000,73.0000,74.0000,75.0000,76.0000,77.0000,78.0000,79.2000,80.4000,81.8000,83.4000,84.8000,86.2000,
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4030.8000,4031.0000,4031.8000,4032.8000,4034.0000,4035.2000,4036.8000,4038.0000,4039.3999,4040.8000,4042.0000,4043.6001,4044.8000,4046.0000,4047.80
};


// RPM INSTANTIATIONS 
float leftrevolutions=0;
float rightrevolutions=0;
float leftrpm=0; // max value 32,767 16 bit
float rightrpm=0; 
long  startTime=0;
long  elapsedTime;

struct RPM{
  float left; 
  float right; 
};

// WIFI INSTANTIATIONS
const char* ssid = "Dan";
const char* password = "muanha21";

// creating an AsyncWebServer object on port 80
AsyncWebServer server(80);
//WiFiServer server(80);
//create a websocket object
AsyncWebSocket ws("/ws");

//Json variable to hold sensor readings
JSONVar readings;

// Timer variables
unsigned long lastTime = 0;
unsigned long timerDelay = 300;

//Initialize SPIFFS 
void initSPIFFS() {
  if (!SPIFFS.begin(true)) {
    Serial.println("An error has occurred while mounting SPIFFS");
  }
  Serial.println("SPIFFS mounted successfully");
}

// Initialize WiFi
void initWiFi() {
  WiFi.mode(WIFI_STA);
  //hotspot ssid and password 
  WiFi.begin(ssid, password);
  Serial.print("Connecting to WiFi ..");
  while (WiFi.status() != WL_CONNECTED) {
    Serial.println("Connecting...");
    Serial.print("Status: ");
    Serial.println(WiFi.status());
    delay(1000);
  }
  Serial.println(WiFi.localIP());
  Serial.println("Connected to WiFi");
}

void notifyClients(String sensorReadings) {
  ws.textAll(sensorReadings);
}

void handleWebSocketMessage(void *arg, uint8_t *data, size_t len) {
  AwsFrameInfo *info = (AwsFrameInfo*)arg;
  if (info->final && info->index == 0 && info->len == len && info->opcode == WS_TEXT) {
    //data[len] = 0;
    //String message = (char*)data;
    // Check if the message is "getReadings"
    //if (strcmp((char*)data, "getReadings") == 0) {
      //if it is, send current sensor readings
      String sensorReadings = getSensorReadings();
      Serial.print(sensorReadings);
      // send to data A&A function 
      notifyClients(sensorReadings);
    //}
  }
}

void onEvent(AsyncWebSocket *server, AsyncWebSocketClient *client, AwsEventType type, void *arg, uint8_t *data, size_t len) {
  switch (type) {
    case WS_EVT_CONNECT:
      Serial.printf("WebSocket client #%u connected from %s\n", client->id(), client->remoteIP().toString().c_str());
      break;
    case WS_EVT_DISCONNECT:
      Serial.printf("WebSocket client #%u disconnected\n", client->id());
      break;
    case WS_EVT_DATA:
      handleWebSocketMessage(arg, data, len);
      break;
    case WS_EVT_PONG:
    case WS_EVT_ERROR:
      break;
  }
}

void initWebSocket() {
  ws.onEvent(onEvent);
  server.addHandler(&ws);
}

RPM getRPMInterrupt(int left, int right){ //calculating using interrupts 
  RPM values; 
  leftrpm=0;
  rightrpm=0; 
  startTime=millis();  
  leftrevolutions = 0; 
    //attachInterrupt(digitalPinToInterrupt(25),leftInterrupt,RISING);  
  rightrevolutions = 0; 
    //attachInterrupt(digitalPinToInterrupt(26),rightInterrupt,RISING);  
  delay(1000);
  //detachInterrupt(2);                
  
  //now let's see how many counts we've had from the hall effect sensor and calc the RPM
  elapsedTime=millis()-startTime;     //finds the time, should be very close to 1 sec
  
    if(leftrevolutions>0){
  
    leftrpm = max(1.0f, leftrevolutions);       //calculates rpm
    leftrpm = (leftrpm * 60000) / elapsedTime; 
    }
  String outMsg = String(); 
  outMsg = String("LEFT RPM :") + leftrpm;
  Serial.println(outMsg);
  
    if(rightrevolutions>0){
  
    rightrpm = max(1.0f, rightrevolutions);       //calculates rpm
    rightrpm = (rightrpm * 60000) / elapsedTime; 
    } 
  outMsg = String("RIGHT RPM :") + rightrpm;
  Serial.println(outMsg);
  values.left = leftrpm; 
  values.right = rightrpm; 
  
  return values;  
}

float getTemp(){
  double Vout, Rt = 0;
  double T, Tc, Tf = 0;

  double adc = 0;
  if (esp32) {
    adc = analogRead(ThermistorPin);
    adc = ADC_LUT[(int)adc];
  }
  else {
    adc = analogRead(ThermistorPin);
  }
  Vout = adc * Vs/adcMax;
  Rt = R1 * Vout / (Vs - Vout);

  T = 1/(1/To + log(Rt/Ro)/Beta);    // Temperature in Kelvin
  Tc = T - 273.15;                   // Celsius
  Tf = Tc * 9 / 5 + 32;              // Fahrenheit
  if (Tc > 0) {
    Serial.println(Tc);
    return Tc; 
  }

  //delay(2000);
}


String getSensorReadings(){
  RPM value = getRPMInterrupt(25,26);
  readings["RIGHT RPM"] = String(value.right);
  readings["LEFT RPM"] = String(value.left);
  readings["temperature"] = String(getTemp()); 
  String jsonString = JSON.stringify(readings);
  Serial.println("JSON STRING");
  Serial.println(jsonString);
  return jsonString;
}

void leftInterrupt() {
    // Handle data or actions related to the left interrupt pin
    //Serial.println("Interrupt from left pin");
    leftrevolutions++;
}

void rightInterrupt() {
    // Handle data or actions related to the left interrupt pin
    //Serial.println("Interrupt from left pin");
    rightrevolutions++;
}

void setup() {
  Serial.begin(115200);
  if (esp32) {
    ThermistorPin = 39;
    adcMax = 4095.0; // ADC resolution 12-bit (0-4095)
    Vs = 3.3;        // supply voltage
  }
  else {
    ThermistorPin = A0;
    adcMax = 1023.0; // ADC resolution 10-bit (0-1023)
    Vs = 5.0;          // supply voltage
  }
  initWiFi();
  initSPIFFS();
  initWebSocket();
  pinMode(25, INPUT);           // set pin to input LEFT
  pinMode(26, INPUT); // RIGHT
  attachInterrupt(digitalPinToInterrupt(25),leftInterrupt,RISING); 
  attachInterrupt(digitalPinToInterrupt(26),rightInterrupt,RISING); 

  // Web Server Root URL
  server.on("/", HTTP_GET, [](AsyncWebServerRequest *request) {
    // send html stuff to their server 
    request->send(SPIFFS, "/index.html", "text/html");
  });

  server.serveStatic("/", SPIFFS, "/");

  // Start server
  server.begin();
}

void loop() {
  if ((millis() - lastTime) > timerDelay) {
    String sensorReadings = getSensorReadings();
    Serial.print(sensorReadings);
    notifyClients(sensorReadings);

  lastTime = millis();
  Serial.println(WiFi.localIP());

  }
  ws.cleanupClients();
}
